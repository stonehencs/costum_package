## br2apps/package/bence/Config.in
```kconfig
config BR2_PACKAGE_BENCE
    bool "bence"
    help
      A 'bence' nevű csomag, amely két egyszerű C programot tartalmaz:
      - Egy "Hello World!" üzenet kiírása.
      - Egy karácsonyfa kirajzolása soros terminálra.
```

## br2apps/package/hello/Config.in
```kconfig
config BR2_PACKAGE_HELLO
    bool "hello"
    help
      Egy egyszerű Hello World alkalmazás C-ben.
```
